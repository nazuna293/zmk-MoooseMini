## boards/shields/MoooseMini/Kconfig.defconfig
```kconfig
if SHIELD_MoooseMini

config ZMK_KEYBOARD_NAME
    default "MoooseMini"

config ZMK_USB
	default y

config ZMK_BLE
	default y

config ZMK_MOUSE
	default y

config ZMK_POINTING
	default y

config SPI
	default y

config INPUT
	default y

config NFCT_PINS_AS_GPIOS
	default y

endif
```

## config/west.yml
```yaml
manifest:
  remotes:
    - name: zmkfirmware
      url-base: https://github.com/zmkfirmware
    - name: badjeff
      url-base: https://github.com/badjeff
    - name: kot149
      url-base: https://github.com/kot149
    - name: ssbb
      url-base: https://github.com/ssbb
    - name: caksoylar
      url-base: https://github.com/caksoylar
  projects:
    - name: zmk
      remote: zmkfirmware
      revision: 64daf698e073e37b6748ac54f4eb48d8666af0b9
      import: app/west.yml
    - name: zmk-pmw3610-driver
      remote: badjeff
      revision: zmk-0.4
    - name: zmk-layout-shift
      remote: kot149
      revision: v2
    - name: zmk-scroll-snap
      remote: kot149
      revision: v1
    - name: zmk-mouse-gesture
      remote: kot149
      revision: v1
    - name: zmk-listeners
      remote: ssbb
      revision: v1
    - name: zmk-rgbled-widget
      remote: caksoylar
      revision: main
  self:
    path: config
```
